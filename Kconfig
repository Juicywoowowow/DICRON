## Kconfig
```kconfig
mainmenu "DICRON Kernel Configuration"

config DICRON_VERSION
	string
	default "0.3.0"

source "kernel/Kconfig"
source "kernel/Kconfig.drivers"
source "kernel/Kconfig.tests"
```

## kernel/Kconfig
```kconfig
menu "Kernel Features"

config FRAMEBUFFER
	bool "Framebuffer console"
	default y
	help
	  Enable the graphical framebuffer console.
	  If disabled, output goes to serial only.

config SSE
	bool "Enable SSE support"
	default y
	help
	  Enable SSE/SSE2 in the kernel for user programs.

config SWAP
	bool "Enable swap support (ZRAM + disk)"
	default y
	help
	  Cooperative page reclaim via ZRAM (compressed RAM) and
	  optional disk swap (tail-of-ATA-disk).  When enabled,
	  PMM OOM triggers swap_try_reclaim() before giving up.

config ZRAM
	bool "Enable ZRAM (compressed RAM swap)"
	default y
	depends on SWAP
	help
	  Compress reclaimable pages into kernel heap using LZO.
	  Works even without a disk.  Effective for mostly-zero pages.

config DEMAND_PAGING
	bool "Enable demand paging"
	default y
	depends on SWAP
	help
	  Defer physical frame allocation until a page is first accessed.
	  ELF segments, anonymous mmap, and brk pages are all mapped as
	  not-present demand PTEs.  A page fault allocates and populates
	  the frame on first touch.  Significantly reduces startup memory
	  usage and makes large-binary loading nearly instantaneous.
	  Requires CONFIG_SWAP for the unified fault handler path.

config INITRD
	bool "Load initrd from Limine module"
	default y
	help
	  Extract a cpio initrd archive at boot and populate ramfs.

config VERBOSE_SYSCALL
	bool "Verbose syscall logging"
	default n
	help
	  Log warnings for unimplemented and out-of-bounds syscalls.
	  Useful for debugging, noisy in production.

config QEMU_CI_EXIT
	bool "QEMU CI exit device (isa-debug-exit)"
	default y
	help
	  After all boot and post-boot tests complete, write to the QEMU
	  isa-debug-exit port (0xf4) so QEMU terminates with a predictable
	  exit code instead of spinning in the idle loop.
	  Writing 0x10 → host exit code 33 (success).
	  Writing 0x00 → host exit code  1 (failure).
	  Enable this only when running under QEMU with:
	    -device isa-debug-exit,iobase=0xf4,iosize=0x04
	  The 'make ci-run' target sets this automatically.

menu "Kernel log levels"

config KLOG_SHOW_EMERG
	bool "Show EMERG messages"
	default y

config KLOG_SHOW_ERR
	bool "Show ERR messages"
	default y

config KLOG_SHOW_WARN
	bool "Show WARN messages"
	default y

config KLOG_SHOW_INFO
	bool "Show INFO messages"
	default y

config KLOG_SHOW_DEBUG
	bool "Show DEBUG messages"
	default n

endmenu

endmenu
```

## kernel/Kconfig.drivers
```kconfig
menu "Drivers"

config SERIAL
	bool "Serial port (COM1)"
	default y

config PS2_KBD
	bool "PS/2 keyboard"
	default y

config PIT
	bool "PIT timer"
	default y

config EXT2
	bool "ext2 filesystem driver"
	default y
	help
	  Read-write ext2 filesystem support.

config EXT2_CHECK
	bool "ext2 integrity checks"
	default y
	depends on EXT2
	help
	  Run validation checks on superblocks, inodes, and directories
	  during mount and I/O. Slight performance cost but catches
	  corruption early.

config EXT2_SYNC
	bool "ext2 sync/flush support"
	default y
	depends on EXT2
	help
	  Dirty tracking and metadata flush on sync/unmount.
	  Ensures writes are persisted and clean unmount state is set.

config RAMDISK
	bool "RAM block device"
	default y
	help
	  Memory-backed block device for loading filesystem images.

config PCI
	bool "PCI bus enumeration"
	default y
	help
	  Scan and enumerate PCI devices at boot.
	  Required for AHCI, NIC, and most modern hardware.

config PCSPEAKER
	bool "PC Speaker / PIT channel 2 driver"
	default y
	depends on PIT
	help
	  Drive the PC speaker via PIT channel 2 (port 0x42/0x43) and
	  the system control port (0x61).  Emits a short beep on boot and
	  a descending three-tone sequence on kernel panic.
	  Uses HPET for timing when CONFIG_HPET is enabled; falls back to
	  a calibrated busy-loop otherwise.

config HPET
	bool "HPET timer"
	default y
	help
	  High Precision Event Timer (HPET) support. Includes nanosecond
	  timing API. Replaces the PIT timer.

endmenu

menu "New Drivers"

comment "Functional but subject to change — enable individually"

config VIRTIO_BLK
	bool "Virtio block device driver"
	default n
	depends on PCI
	help
	  Legacy virtio-blk PCI driver for QEMU virtio disk images.
	  Performs synchronous polled I/O via virtqueue 0.
	  Supports up to 4 virtio-blk disks per QEMU instance.
	  Requires PCI enumeration (CONFIG_PCI).

config TEST_VIRTIO_DRIVE
	bool "Create temporary virtio-blk disk for QEMU testing"
	default n
	depends on VIRTIO_BLK
	help
	  When enabled, the QEMU run targets (run / setram / ranmem) will
	  automatically create an 8 MB raw disk image, attach it to QEMU
	  as a virtio-blk device, and delete the image when QEMU exits.
	  Useful for exercising the virtio-blk driver against a real
	  (emulated) disk without keeping a permanent image around.

menu "ATA / Disk"

config ATA
	bool "ATA PIO disk driver"
	default n
	help
	  ATA PIO-mode disk driver for IDE hard drives.
	  Required for persistent storage on real or emulated hardware.

config ATA_PRIMARY
	bool "Probe primary ATA bus (0x1F0)"
	default y
	depends on ATA

config ATA_SECONDARY
	bool "Probe secondary ATA bus (0x170)"
	default n
	depends on ATA

config PARTITION_MBR
	bool "MBR partition table support"
	default y
	depends on ATA
	help
	  Parse MBR partition tables to find ext2 partitions on disk.

config TEST_ATA_DRIVE
	bool "Create temporary test ATA drive for QEMU"
	default n
	depends on ATA
	help
	  When enabled, the QEMU run targets will automatically create
	  a small raw disk image, attach it as a secondary IDE drive,
	  and delete it when QEMU exits. Useful for testing ATA and
	  partition code against a real (emulated) disk.

endmenu

menu "SATA / AHCI"

config AHCI
	bool "AHCI controller driver"
	default n
	depends on PCI
	help
	  AHCI (Advanced Host Controller Interface) driver.
	  Provides DMA-based access to SATA ports via PCI BAR5.
	  Required by the SATA device driver.

config SATA
	bool "SATA device driver"
	default n
	depends on AHCI
	help
	  SATA device detection, IDENTIFY, and DMA read/write.
	  Provides struct blkdev for each attached SATA disk.

config TEST_SATA_DRIVE
	bool "Create temporary SATA disk for QEMU testing"
	default n
	depends on SATA
	help
	  When enabled, the QEMU run targets will automatically create
	  an 8 MB raw disk image, attach it as a SATA drive on the Q35
	  ICH9-AHCI controller, and delete the image when QEMU exits.

endmenu

endmenu

menu "Staged Drivers"

comment "Experimental / unstable — disabled by default"

endmenu
```

## kernel/Kconfig.tests
```kconfig
menu "Tests"

config TESTS
	bool "Enable kernel test harness"
	default y
	help
	  Master switch for all kernel tests.
	  Disabling this removes ALL test code from the binary.

config TESTS_SHOW_VERBOSE
	bool "Show verbose boot test output"
	default n
	depends on TESTS
	help
	  Display individual test suite names and detailed
	  pass/fail summary during boot. If disabled, only
	  failures and the final total are printed.

if TESTS

config TESTS_BOOT
	bool "Boot-time tests"
	default y
	help
	  Run tests before the scheduler starts.

config TESTS_POST
	bool "Post-boot tests (require scheduler)"
	default y
	help
	  Run tests after the scheduler is live.

menu "Boot test categories"
	depends on TESTS_BOOT

config TESTS_PMM
	bool "PMM (physical memory) tests"
	default y

config TESTS_VMM
	bool "VMM (virtual memory) tests"
	default y

config TESTS_KHEAP
	bool "Kernel heap tests"
	default y

config TESTS_SLAB
	bool "Slab allocator tests"
	default y

config TESTS_SCHED
	bool "Scheduler tests"
	default y

config TESTS_MLFQ
	bool "MLFQ tests"
	default y

config TESTS_FS
	bool "Filesystem tests (VFS, ramfs, devfs)"
	default y

config TESTS_CPIO
	bool "CPIO parser tests"
	default y

config TESTS_BLKDEV
	bool "Block device tests"
	default y

config TESTS_EXT2
	bool "ext2 structure tests"
	default y
	depends on EXT2

config TESTS_EXT2_WRITE
	bool "ext2 write-path tests"
	default y
	depends on EXT2 && RAMDISK
	help
	  Tests for ext2 bitmap alloc/free, inode write-back,
	  file creation, mkdir, file write, and unlink.
	  Requires both ext2 driver and ramdisk block device.

config TESTS_STRING
	bool "String/math/misc tests"
	default y

config TESTS_SPINLOCK
	bool "Spinlock tests"
	default y

config TESTS_IDT
	bool "IDT/interrupt tests"
	default y

config TESTS_TIMER
	bool "Timer tests"
	default y

config TESTS_HPET
	bool "HPET tests"
	default y
	depends on HPET

config TESTS_KSTACK
	bool "Kernel stack tests"
	default y

config TESTS_ERROR
	bool "Error recovery tests"
	default y

config TESTS_FUZZ
	bool "Fuzz tests"
	default y

config TESTS_PCI
	bool "PCI bus tests"
	default y
	depends on PCI

config TESTS_RTC
	bool "RTC clock tests"
	default y

config TESTS_ATA
	bool "ATA driver tests"
	default y
	depends on ATA

config TESTS_PARTITION
	bool "Partition table tests"
	default y
	depends on ATA && PARTITION_MBR

endmenu

menu "Post-boot test categories"
	depends on TESTS_POST

config TESTS_POST_SCHED
	bool "Post-boot scheduler tests"
	default y

config TESTS_POST_SYSCALL
	bool "Post-boot syscall tests"
	default y

config TESTS_POST_ELF
	bool "Post-boot ELF loader tests"
	default y

endmenu

endif # TESTS

endmenu
```
